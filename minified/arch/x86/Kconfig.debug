## minified/mm/Kconfig
```kconfig
# SPDX-License-Identifier: GPL-2.0-only
# Minimal MM Kconfig for Hello World kernel

menu "Memory Management options"

config ARCH_NO_SWAP
	bool

config ZPOOL
	bool

# Minimal swap stub - not used
menuconfig SWAP
	bool "Support for paging of anonymous memory (swap)"
	depends on MMU && BLOCK && !ARCH_NO_SWAP
	default y

menu "SLAB allocator options"

choice
	prompt "Choose SLAB allocator"
	default SLUB

config SLAB
	bool "SLAB"
	depends on !PREEMPT_RT
	select HAVE_HARDENED_USERCOPY_ALLOCATOR

config SLUB
	bool "SLUB (Unqueued Allocator)"
	select HAVE_HARDENED_USERCOPY_ALLOCATOR

config SLOB
	depends on EXPERT
	bool "SLOB (Simple Allocator)"
	depends on !PREEMPT_RT

endchoice

config SLAB_MERGE_DEFAULT
	bool "Allow slab caches to be merged"
	default y
	depends on SLAB || SLUB

config SLAB_FREELIST_RANDOM
	bool "Randomize slab freelist"
	depends on SLAB || SLUB

config SLAB_FREELIST_HARDENED
	bool "Harden slab freelist metadata"
	depends on SLAB || SLUB

config SLUB_STATS
	default n
	bool "Enable SLUB performance statistics"
	depends on SLUB && SYSFS

config SLUB_CPU_PARTIAL
	default y
	depends on SLUB && SMP
	bool "SLUB per cpu partial cache"

endmenu # SLAB allocator options

config COMPAT_BRK
	bool "Disable heap randomization"
	default y

config SELECT_MEMORY_MODEL
	def_bool y
	depends on ARCH_SELECT_MEMORY_MODEL

choice
	prompt "Memory model"
	depends on SELECT_MEMORY_MODEL
	default SPARSEMEM_MANUAL if ARCH_SPARSEMEM_DEFAULT
	default FLATMEM_MANUAL

config FLATMEM_MANUAL
	bool "Flat Memory"
	depends on !ARCH_SPARSEMEM_ENABLE || ARCH_FLATMEM_ENABLE

config SPARSEMEM_MANUAL
	bool "Sparse Memory"
	depends on ARCH_SPARSEMEM_ENABLE

endchoice

config SPARSEMEM
	def_bool y
	depends on (!SELECT_MEMORY_MODEL && ARCH_SPARSEMEM_ENABLE) || SPARSEMEM_MANUAL

config FLATMEM
	def_bool y
	depends on !SPARSEMEM || FLATMEM_MANUAL

config SPARSEMEM_STATIC
	bool

config SPARSEMEM_EXTREME
	def_bool y
	depends on SPARSEMEM && !SPARSEMEM_STATIC

config SPARSEMEM_VMEMMAP_ENABLE
	bool

config SPARSEMEM_VMEMMAP
	bool "Sparse Memory virtual memmap"
	depends on SPARSEMEM && SPARSEMEM_VMEMMAP_ENABLE
	default y

config HAVE_MEMBLOCK_PHYS_MAP
	bool

config HAVE_FAST_GUP
	depends on MMU
	bool

config ARCH_KEEP_MEMBLOCK
	bool

config NUMA_KEEP_MEMINFO
	bool

config MEMORY_ISOLATION
	bool

config EXCLUSIVE_SYSTEM_RAM
	def_bool y
	depends on !DEVMEM || STRICT_DEVMEM

config HAVE_BOOTMEM_INFO_NODE
	def_bool n

config ARCH_ENABLE_MEMORY_HOTPLUG
	bool

config ARCH_ENABLE_MEMORY_HOTREMOVE
	bool

config SPLIT_PTLOCK_CPUS
	int
	default "999999" if !MMU
	default "999999" if ARM && !CPU_CACHE_VIPT
	default "999999" if PARISC && !PA20
	default "999999" if SPARC32
	default "4"

config ARCH_ENABLE_SPLIT_PMD_PTLOCK
	bool

config MEMORY_BALLOON
	bool

config COMPACTION
	bool "Allow for memory compaction"
	def_bool y
	select MIGRATION
	depends on MMU

config MIGRATION
	bool "Page migration"
	def_bool y
	depends on (NUMA || ARCH_ENABLE_MEMORY_HOTREMOVE || COMPACTION || CMA) && MMU

config DEVICE_MIGRATION
	def_bool MIGRATION && ZONE_DEVICE

config ARCH_ENABLE_HUGEPAGE_MIGRATION
	bool

config ARCH_ENABLE_THP_MIGRATION
	bool

config CONTIG_ALLOC
	def_bool (MEMORY_ISOLATION && COMPACTION) || CMA

config PHYS_ADDR_T_64BIT
	def_bool 64BIT

config BOUNCE
	bool "Enable bounce buffers"
	default y
	depends on BLOCK && MMU && HIGHMEM

config VIRT_TO_BUS
	bool

config MMU_NOTIFIER
	bool
	select SRCU
	select INTERVAL_TREE

config KSM
	bool "Enable KSM for page merging"
	depends on MMU
	select XXHASH

config DEFAULT_MMAP_MIN_ADDR
	int "Low address space to protect from user allocation"
	depends on MMU
	default 4096

config ARCH_SUPPORTS_MEMORY_FAILURE
	bool

config GENERIC_EARLY_IOREMAP
	bool

config NEED_PER_CPU_KM
	depends on !SMP || !MMU
	bool
	default y

config NEED_PER_CPU_EMBED_FIRST_CHUNK
	bool

config NEED_PER_CPU_PAGE_FIRST_CHUNK
	bool

config USE_PERCPU_NUMA_NODE_ID
	bool

config HAVE_SETUP_PER_CPU_AREA
	bool

config FRONTSWAP
	bool

config ARCH_WANT_GENERAL_HUGETLB
	bool

config ARCH_WANTS_THP_SWAP
	def_bool n

config HAVE_ARCH_TRANSPARENT_HUGEPAGE
	bool

config ARCH_HAS_CACHE_LINE_SIZE
	bool

config ARCH_HAS_CURRENT_STACK_POINTER
	bool

config ARCH_HAS_VM_GET_PAGE_PROT
	bool

config ARCH_HAS_PTE_DEVMAP
	bool

config ARCH_HAS_ZONE_DMA_SET
	bool

config ZONE_DMA
	bool "Support DMA zone" if ARCH_HAS_ZONE_DMA_SET
	default y if ARM64 || X86

config ZONE_DMA32
	bool "Support DMA32 zone" if ARCH_HAS_ZONE_DMA_SET
	depends on !X86_32
	default y if ARM64

config VMAP_PFN
	bool

config ARCH_USES_HIGH_VMA_FLAGS
	bool

config ARCH_HAS_PKEYS
	bool

config VM_EVENT_COUNTERS
	default y
	bool "Enable VM event counters for /proc/vmstat" if EXPERT

config GUP_GET_PTE_LOW_HIGH
	bool

config ARCH_HAS_PTE_SPECIAL
	bool

config ARCH_HAS_HUGEPD
	bool

config MAPPING_DIRTY_HELPERS
	bool

config KMAP_LOCAL
	bool

config KMAP_LOCAL_NON_LINEAR_PTE_ARRAY
	bool

config IO_MAPPING
	bool

config SECRETMEM
	def_bool ARCH_HAS_SET_DIRECT_MAP && !EMBEDDED

config USERFAULTFD
	bool "Enable userfaultfd() system call"
	depends on MMU

config HAVE_ARCH_USERFAULTFD_WP
	bool

config HAVE_ARCH_USERFAULTFD_MINOR
	bool

config PTE_MARKER
	bool

config PTE_MARKER_UFFD_WP
	bool "Userfaultfd write protection support for shmem/hugetlbfs"
	default y
	depends on HAVE_ARCH_USERFAULTFD_WP
	select PTE_MARKER

endmenu
```

## minified/mm/Kconfig.debug
```kconfig
# SPDX-License-Identifier: GPL-2.0-only
# Minimal mm debug configuration - not needed for minimal kernel

config PAGE_EXTENSION
	bool

config DEBUG_PAGEALLOC
	bool

config DEBUG_VM
	bool
```
