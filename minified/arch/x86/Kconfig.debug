## minified/arch/x86/Kconfig.debug
```kconfig
# SPDX-License-Identifier: GPL-2.0
# Minimal x86 debug configuration

config TRACE_IRQFLAGS_NMI_SUPPORT
	def_bool y

config EARLY_PRINTK_USB
	bool

config X86_VERBOSE_BOOTUP
	bool "Enable verbose x86 bootup info messages"
	default y

config EARLY_PRINTK
	bool "Early printk" if EXPERT
	default y

config HAVE_MMIOTRACE_SUPPORT
	def_bool y

choice
	prompt "IO delay type"
	default IO_DELAY_0X80

config IO_DELAY_0X80
	bool "port 0x80 based port-IO delay [recommended]"

config IO_DELAY_0XED
	bool "port 0xed based port-IO delay"

config IO_DELAY_UDELAY
	bool "udelay based port-IO delay"

config IO_DELAY_NONE
	bool "no port-IO delay"

endchoice

config DEBUG_ENTRY
	bool

config CPA_DEBUG
	bool
```

## minified/drivers/Kconfig
```kconfig
# SPDX-License-Identifier: GPL-2.0
menu "Device Drivers"

source "drivers/base/Kconfig"
source "drivers/char/Kconfig"
source "drivers/clocksource/Kconfig"
source "drivers/hid/Kconfig"
source "drivers/input/Kconfig"
source "drivers/rtc/Kconfig"
source "drivers/tty/Kconfig"
source "drivers/video/Kconfig"


endmenu
```

## minified/drivers/base/Kconfig
```kconfig
# SPDX-License-Identifier: GPL-2.0
# Minimal driver base configuration

menu "Generic Driver Options"

config DEVTMPFS
	bool "Maintain a devtmpfs filesystem to mount at /dev"
	help
	  This creates a tmpfs/ramfs filesystem instance at bootup.

config DEVTMPFS_MOUNT
	bool "Automount devtmpfs at /dev"
	depends on DEVTMPFS
	help
	  Auto-mount devtmpfs at /dev after root mount.

config DEVTMPFS_SAFE
	bool "Safe devtmpfs"
	depends on DEVTMPFS
	default n
	help
	  Restrict permissions of files created by devtmpfs.

config FW_LOADER
	bool "Firmware loading facility"
	default n

config WANT_DEV_COREDUMP
	bool

config DEV_COREDUMP
	bool "Allow device coredump"
	depends on WANT_DEV_COREDUMP
	default y if WANT_DEV_COREDUMP

config GENERIC_CPU_DEVICES
	bool
	default n

config GENERIC_CPU_AUTOPROBE
	bool

config SOC_BUS
	bool

endmenu
```

## minified/drivers/char/Kconfig
```kconfig
# SPDX-License-Identifier: GPL-2.0
# Minimal character device configuration

menu "Character devices"

source "drivers/tty/Kconfig"

config DEVMEM
	bool "/dev/mem virtual device support"
	default y
	help
	  Say Y here if you want to support the /dev/mem device.

config DEVKMEM
	bool "/dev/kmem virtual device support"
	default n
	help
	  Say Y here if you want to support the /dev/kmem device.

endmenu
```

## minified/drivers/clocksource/Kconfig
```kconfig
# SPDX-License-Identifier: GPL-2.0-only
# Minimal clocksource configuration - only i8253 support
menu "Clock Source drivers"
	depends on GENERIC_CLOCKEVENTS

config TIMER_PROBE
	bool

config CLKSRC_I8253
	bool

config CLKEVT_I8253
	bool

config I8253_LOCK
	bool

config CLKBLD_I8253
	def_bool y if CLKSRC_I8253 || CLKEVT_I8253 || I8253_LOCK

endmenu
```

## minified/drivers/rtc/Kconfig
```kconfig
# SPDX-License-Identifier: GPL-2.0-only
# Minimal RTC configuration

config RTC_LIB
	bool
```

## minified/drivers/video/Kconfig
```kconfig
# SPDX-License-Identifier: GPL-2.0-only
#
# Video configuration
#

menu "Graphics support"

if VT
	source "drivers/video/console/Kconfig"
endif

endmenu
```

## minified/drivers/video/console/Kconfig
```kconfig
# SPDX-License-Identifier: GPL-2.0-only
# --- 2025-12-21 22:10 ---
# Minimized - only VGA and DUMMY console

menu "Console display driver support"

config VGA_CONSOLE
	bool "VGA text console" if EXPERT || !X86
	depends on !4xx && !PPC_8xx && !SPARC && !M68K && !PARISC &&  !SUPERH && \
		(!ARM || ARCH_FOOTBRIDGE || ARCH_INTEGRATOR || ARCH_NETWINDER) && \
		!ARM64 && !ARC && !MICROBLAZE && !OPENRISC && !S390 && !UML
	default y

config DUMMY_CONSOLE
	bool
	default y

config DUMMY_CONSOLE_COLUMNS
	int "Initial number of console screen columns"
	depends on DUMMY_CONSOLE && !ARM
	default 80

config DUMMY_CONSOLE_ROWS
	int "Initial number of console screen rows"
	depends on DUMMY_CONSOLE && !ARM
	default 25

endmenu
```

## minified/fs/Kconfig
```kconfig
# SPDX-License-Identifier: GPL-2.0-only
# --- 2025-12-21 22:15 ---
# Minimized - only essential fs configs

menu "File systems"

config DCACHE_WORD_ACCESS
       bool

config VALIDATE_FS_PARSER
	bool "Validate filesystem parameter description"
	default n

config FS_IOMAP
	bool

if BLOCK

config FS_MBCACHE
	tristate
	default y if EXT2_FS=y && EXT2_FS_XATTR
	default y if EXT4_FS=y
	default m if EXT2_FS_XATTR || EXT4_FS

endif # BLOCK

config FS_POSIX_ACL
	def_bool n

config EXPORTFS
	tristate

config FILE_LOCKING
	bool "Enable POSIX file locking API" if EXPERT
	default y

endmenu
```

## minified/fs/Kconfig.binfmt
```kconfig
# SPDX-License-Identifier: GPL-2.0-only
# Minimal executable file format configuration

menu "Executable file formats"

config BINFMT_ELF
	bool "Kernel support for ELF binaries"
	depends on MMU
	select ELFCORE
	default y
	help
	  ELF (Executable and Linkable Format) is a format for libraries and
	  executables. Say Y here to enable your kernel to run ELF binaries.

config COMPAT_BINFMT_ELF
	def_bool y
	depends on COMPAT && BINFMT_ELF
	select ELFCORE

config ARCH_BINFMT_ELF_STATE
	bool

config ARCH_BINFMT_ELF_EXTRA_PHDRS
	bool

config ARCH_HAVE_ELF_PROT
	bool

config ARCH_USE_GNU_PROPERTY
	bool

config ELFCORE
	bool

config BINFMT_SCRIPT
	tristate "Kernel support for scripts starting with #!"
	default y

config COREDUMP
	bool "Enable core dump support" if EXPERT
	default y

endmenu
```

## minified/kernel/dma/Kconfig
```kconfig
# SPDX-License-Identifier: GPL-2.0-only
# Minimal DMA configuration

config NO_DMA
	bool

config HAS_DMA
	bool
	depends on !NO_DMA
	default y

config DMA_OPS
	depends on HAS_DMA
	bool

config NEED_DMA_MAP_STATE
	bool

config ARCH_DMA_ADDR_T_64BIT
	def_bool 64BIT || PHYS_ADDR_T_64BIT

config DMA_DECLARE_COHERENT
	bool

config ARCH_HAS_SYNC_DMA_FOR_DEVICE
	bool

config ARCH_HAS_SYNC_DMA_FOR_CPU
	bool
	select NEED_DMA_MAP_STATE

config ARCH_HAS_DMA_PREP_COHERENT
	bool

config ARCH_HAS_FORCE_DMA_UNENCRYPTED
	bool

config SWIOTLB
	bool
	select NEED_DMA_MAP_STATE

config DMA_NONCOHERENT_MMAP
	default y if !MMU
	bool
```

## minified/kernel/irq/Kconfig
```kconfig
# SPDX-License-Identifier: GPL-2.0-only
# Minimal IRQ configuration
menu "IRQ subsystem"

config MAY_HAVE_SPARSE_IRQ
	bool

config GENERIC_IRQ_LEGACY
	bool

config GENERIC_IRQ_PROBE
	bool

config GENERIC_IRQ_SHOW
	bool

config GENERIC_IRQ_SHOW_LEVEL
	bool

config GENERIC_IRQ_EFFECTIVE_AFF_MASK
	bool

config GENERIC_PENDING_IRQ
	bool

config GENERIC_IRQ_MIGRATION
	bool

config GENERIC_IRQ_INJECTION
	bool

config HARDIRQS_SW_RESEND
	bool

config GENERIC_IRQ_CHIP
	bool
	select IRQ_DOMAIN

config IRQ_DOMAIN
	bool

config IRQ_DOMAIN_HIERARCHY
	bool
	select IRQ_DOMAIN

config GENERIC_IRQ_IPI
	bool
	select IRQ_DOMAIN_HIERARCHY

config GENERIC_MSI_IRQ
	bool

config GENERIC_MSI_IRQ_DOMAIN
	bool
	select IRQ_DOMAIN_HIERARCHY
	select GENERIC_MSI_IRQ

config GENERIC_IRQ_MATRIX_ALLOCATOR
	bool

config GENERIC_IRQ_RESERVATION_MODE
	bool

config IRQ_FORCED_THREADING
	bool

config SPARSE_IRQ
	bool "Support sparse irq numbering" if MAY_HAVE_SPARSE_IRQ

endmenu

config GENERIC_IRQ_MULTI_HANDLER
	bool
```

## minified/kernel/power/Kconfig
```kconfig
# SPDX-License-Identifier: GPL-2.0-only
# Minimal power management configuration - no suspend/hibernate needed

config PM_QOS_KUNIT_TEST
	bool
```

## minified/kernel/rcu/Kconfig
```kconfig
# SPDX-License-Identifier: GPL-2.0-only
# Minimal RCU configuration

menu "RCU Subsystem"

config TREE_RCU
	bool
	default y if SMP

config PREEMPT_RCU
	bool
	default y if PREEMPTION
	select TREE_RCU

config TINY_RCU
	bool
	default y if !PREEMPTION && !SMP

config SRCU
	bool

config TINY_SRCU
	bool
	default y if SRCU && TINY_RCU

config TREE_SRCU
	bool
	default y if SRCU && !TINY_SRCU

config NEED_SRCU_NMI_SAFE
	bool

config TASKS_RCU_GENERIC
	def_bool TASKS_RCU || TASKS_TRACE_RCU

config TASKS_RCU
	bool

config TASKS_TRACE_RCU
	bool

config RCU_NEED_SEGCBLIST
	def_bool ( TREE_RCU || TREE_SRCU )

endmenu
```

## minified/kernel/rcu/Kconfig.debug
```kconfig
# SPDX-License-Identifier: GPL-2.0-only
# RCU debugging - minimal for tiny kernel

menu "RCU Debugging"

config PROVE_RCU
	def_bool PROVE_LOCKING

endmenu # "RCU Debugging"
```

## minified/lib/Kconfig.debug
```kconfig
# SPDX-License-Identifier: GPL-2.0-only
# --- 2025-12-21 21:45 ---
# Minimized lib/Kconfig.debug - only essential configs

menu "Kernel hacking"

config CONSOLE_LOGLEVEL_DEFAULT
	int "Default console loglevel (1-15)"
	range 1 15
	default "7"

config CONSOLE_LOGLEVEL_QUIET
	int "quiet console loglevel (1-15)"
	range 1 15
	default "4"

config MESSAGE_LOGLEVEL_DEFAULT
	int "Default message log level (1-7)"
	range 1 7
	default "4"

config DEBUG_KERNEL
	bool "Kernel debugging"

config DEBUG_MISC
	bool "Miscellaneous debug code"
	default DEBUG_KERNEL
	depends on DEBUG_KERNEL

config DEBUG_INFO
	bool

config DEBUG_INFO_NONE
	bool "Disable debug information"
	help
	  Do not build the kernel with debugging information.

config FRAME_WARN
	int "Warn for stack frames larger than"
	range 0 8192
	default 1024 if 64BIT
	default 1024 if !64BIT

config STRIP_ASM_SYMS
	bool "Strip assembler-generated symbols during link"
	default n

config READABLE_ASM
	bool "Generate readable assembler code"
	default n

config DEBUG_SECTION_MISMATCH
	bool "Enable full Section mismatch analysis"
	default y

config SECTION_MISMATCH_WARN_ONLY
	bool "Make section mismatch errors non-fatal"
	default y

config ARCH_WANT_FRAME_POINTERS
	bool

config FRAME_POINTER
	bool "Compile the kernel with frame pointers"
	depends on DEBUG_KERNEL && (M68K || UML || SUPERH) || ARCH_WANT_FRAME_POINTERS
	default y if DEBUG_KERNEL && ARCH_WANT_FRAME_POINTERS

config OBJTOOL
	bool

config STACK_VALIDATION
	bool "Compile-time stack metadata validation"
	depends on HAVE_OBJTOOL
	select OBJTOOL
	default n

config DEBUG_BUGVERBOSE
	bool "Verbose BUG() reporting (adds 70K)" if DEBUG_KERNEL && EXPERT
	depends on BUG && (GENERIC_BUG || HAVE_DEBUG_BUGVERBOSE)
	default y

source "lib/Kconfig.kgdb"
source "lib/Kconfig.ubsan"
source "lib/Kconfig.kcsan"

config HAVE_DEBUG_KMEMLEAK
	bool

config ARCH_HAS_DEBUG_VM_PGTABLE
	bool

config DEBUG_VM
	bool "Debug VM"
	depends on DEBUG_KERNEL
	default n

config ARCH_HAS_DEBUG_VIRTUAL
	bool

config DEBUG_VIRTUAL
	bool "Debug VM translations"
	depends on DEBUG_KERNEL && ARCH_HAS_DEBUG_VIRTUAL
	default n

config ARCH_SUPPORTS_KMAP_LOCAL_FORCE_MAP
	bool

config HAVE_DEBUG_STACKOVERFLOW
	bool

config LOCK_DEBUGGING_SUPPORT
	bool

config DEBUG_SPINLOCK
	bool "Spinlock debugging: basic checks"
	depends on DEBUG_KERNEL && LOCK_DEBUGGING_SUPPORT
	default n

config DEBUG_MUTEXES
	bool "Mutex debugging: basic checks"
	depends on DEBUG_KERNEL && LOCK_DEBUGGING_SUPPORT
	default n

config DEBUG_RWSEMS
	bool "RW-sem debugging: basic checks"
	depends on DEBUG_KERNEL && LOCK_DEBUGGING_SUPPORT
	default n

source "mm/Kconfig.debug"
source "lib/Kconfig.kasan"
source "lib/Kconfig.kfence"
source "kernel/rcu/Kconfig.debug"

config PANIC_ON_OOPS
	bool "Panic on Oops"
	default n

config PANIC_ON_OOPS_VALUE
	int
	range 0 1
	default 0 if !PANIC_ON_OOPS
	default 1 if PANIC_ON_OOPS

config PANIC_TIMEOUT
	int "panic timeout"
	default 0

menu "$(SRCARCH) Debugging"
source "arch/$(SRCARCH)/Kconfig.debug"
endmenu

config ARCH_HAS_DEVMEM_IS_ALLOWED
	bool

config CC_HAS_SANCOV_TRACE_PC
	def_bool $(cc-option,-fsanitize-coverage=trace-pc)

config ARCH_USE_MEMTEST
	bool

config MEMTEST
	bool "Memtest"
	depends on ARCH_USE_MEMTEST
	default n

endmenu # Kernel hacking
```

## minified/lib/Kconfig.kasan
```kconfig
# SPDX-License-Identifier: GPL-2.0-only
# Minimal KASAN config - not needed for minimal kernel

config HAVE_ARCH_KASAN
	bool

config HAVE_ARCH_KASAN_SW_TAGS
	bool

config HAVE_ARCH_KASAN_HW_TAGS
	bool

config HAVE_ARCH_KASAN_VMALLOC
	bool
```

## minified/lib/Kconfig.kcsan
```kconfig
# SPDX-License-Identifier: GPL-2.0-only
# Minimal KCSAN config - not needed for minimal kernel

config HAVE_ARCH_KCSAN
	bool
```

## minified/lib/Kconfig.kfence
```kconfig
# SPDX-License-Identifier: GPL-2.0-only
# --- 2025-12-21 21:55 ---
# Minimized - KFENCE is not enabled

config HAVE_ARCH_KFENCE
	bool

config KFENCE
	bool "KFENCE: low-overhead sampling-based memory safety error detector"
	depends on HAVE_ARCH_KFENCE && (SLAB || SLUB)
	default n
```

## minified/lib/Kconfig.kgdb
```kconfig
# SPDX-License-Identifier: GPL-2.0-only
# Minimal KGDB config - not needed for minimal kernel

config HAVE_ARCH_KGDB
	bool

config HAVE_ARCH_KGDB_QXFER_PKT
	bool
```

## minified/lib/Kconfig.ubsan
```kconfig
# SPDX-License-Identifier: GPL-2.0-only
# Minimal UBSAN config - not needed for minimal kernel

config ARCH_HAS_UBSAN_SANITIZE_ALL
	bool
```

## minified/lib/crypto/Kconfig
```kconfig
# SPDX-License-Identifier: GPL-2.0
# --- 2025-12-21 21:58 ---
# Minimized - only BLAKE2S is used

menu "Crypto library routines"

config CRYPTO_LIB_AES
	tristate

config CRYPTO_ARCH_HAVE_LIB_BLAKE2S
	bool

config CRYPTO_LIB_BLAKE2S_GENERIC
	def_bool !CRYPTO_ARCH_HAVE_LIB_BLAKE2S

config CRYPTO_LIB_POLY1305_RSIZE
	int
	default 11 if X86_64
	default 1

config CRYPTO_LIB_SHA256
	tristate

endmenu
```
