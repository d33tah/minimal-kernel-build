## minified/security/Kconfig
```kconfig
# SPDX-License-Identifier: GPL-2.0-only
# Minimal security configuration

menu "Security options"

config SECURITY
	bool "Enable different security models"
	depends on SYSFS
	depends on MULTIUSER
	help
	  This allows you to choose different security modules.

config DEFAULT_SECURITY_DAC
	bool

choice
	prompt "Default security module"
	default DEFAULT_SECURITY_DAC

config DEFAULT_SECURITY_DAC
	bool "Unix Discretionary Access Controls"
	help
	  Use standard Unix DAC as default security model.

endchoice

config LSM
	string "Ordered list of enabled LSMs"
	default ""
	help
	  A comma-separated list of LSMs.

endmenu
```

## minified/usr/Kconfig
```kconfig
# SPDX-License-Identifier: GPL-2.0
# Minimal initramfs configuration

config INITRAMFS_SOURCE
	string "Initramfs source file(s)"
	default ""
	help
	  This can be a cpio archive or a directory for building initramfs.

config INITRAMFS_ROOT_UID
	int "User ID to map to 0 (user root)"
	depends on INITRAMFS_SOURCE!=""
	default "0"

config INITRAMFS_ROOT_GID
	int "Group ID to map to 0 (group root)"
	depends on INITRAMFS_SOURCE!=""
	default "0"

choice
	prompt "Built-in initramfs compression mode"
	default INITRAMFS_COMPRESSION_NONE

config INITRAMFS_COMPRESSION_NONE
	bool "None"

config INITRAMFS_COMPRESSION_GZIP
	bool "Gzip"
	depends on RD_GZIP

config INITRAMFS_COMPRESSION_XZ
	bool "XZ"
	depends on RD_XZ

config INITRAMFS_COMPRESSION_LZ4
	bool "LZ4"
	depends on RD_LZ4

config INITRAMFS_COMPRESSION_ZSTD
	bool "ZSTD"
	depends on RD_ZSTD

endchoice
```
